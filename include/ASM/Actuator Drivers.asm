; Liverpool John Moores University
; Msc in Embedded Systems and IC Design
; Semester 1 Project - IoT Medical dispenser
; Lecturer; Dr.Samiru Gayan
; Students Associated;
; Sanidi Sasenya        - 22pg0046
; Pasindu Vihangana     - 22pg0060
; Pasindu Wijewardena   - 22pg0051
; May.2023
; Actuator driver and tray position sensing Assembly coding
; PIC16F73
; Developed using MPLAB IDE v7.00
List p=16F73
include "p16F73.INC"
 __CONFIG _CP_OFF & _XT_OSC & _PWRTE_ON & _WDT_OFF
CBLOCK 0x20
DEL1,DEL2,DEL3,T_ROTATE,STEP_COUNT,FR0,TRAY_POS,TRAY_ADR
ROTATION_COUNTER
ENDC
ORG 10
 BCF STATUS,RP0 ;Select Bank 0 
 CLRF PORTA
 CLRF PORTB
 CLRF PORTC
Initialization_Ports
 BSF STATUS,RP0 ;Select Bank 1 
 MOVLW B'111111'
 MOVWF PORTA
 MOVLW B'10000000'
 MOVWF PORTB
 MOVLW B'11110011'
 MOVWF PORTC
 MOVLW B'00000110' 
 MOVWF ADCON1
 BCF STATUS,RP0 ;Select Bank 0 
;--------------------------------------
 
 CLRF PORTB
 #DEFINE SW1 PORTA,0 ; 1
 #DEFINE SW2 PORTA,1 ; 1
 #DEFINE ADR0 PORTA,2 ; 1
 #DEFINE ADR1 PORTA,3 ; 1
 #DEFINE ADR2 PORTA,4 ; 1
 #DEFINE ADR3 PORTA,5 ; 1
 #DEFINE LOCKPWM PORTB,0 ; 0
 #DEFINE EJTPWM PORTB,1 ; 0
 #DEFINE ST4 PORTB,2 ; 0
 #DEFINE ST3 PORTB,3 ; 0
 #DEFINE ST2 PORTB,4 ; 0
 #DEFINE ST1 PORTB,5 ; 0
 #DEFINE BUSY PORTB,6 ; 0
 #DEFINE LOCK PORTB,7 ; 1
 #DEFINE RTT PORTC,0 ; 1
 #DEFINE EJT PORTC,1 ; 1
 #DEFINE DONE PORTC,2 ; 0
 #DEFINE ERR PORTC,3 ; 0
 #DEFINE IR3 PORTC,4 ; 1
 #DEFINE IR2 PORTC,5 ; 1
 #DEFINE IR1 PORTC,6 ; 1
 #DEFINE IR0 PORTC,7 ; 1
 #DEFINE STEP_1_FLAG FR0,0
 #DEFINE STEP_2_FLAG FR0,1
 #DEFINE STEP_3_FLAG FR0,2
 #DEFINE STEP_4_FLAG FR0,3
 #DEFINE STEP_5_FLAG FR0,4
 #DEFINE STEP_6_FLAG FR0,5
 #DEFINE STEP_7_FLAG FR0,6
 #DEFINE STEP_8_FLAG FR0,7
 #DEFINE ZERO STATUS,Z
 #DEFINE CARRY STATUS,C
 #DEFINE TRAY_OK FR0,0
 #DEFINE POSITION_FLAG FR0,1
;---------MAIN--------------------------
 BCF ERR
 CLRF FR0
MAIN
 BTFSS LOCK ; Check the tray locked
 GOTO SKIP_LOCK ; Not locked
; When locked
 BTFSC SW1 ; Check for eject
 CALL EJECT
SKIP_LOCK ; Not locked
 BTFSC SW2 ; Check for rotate
 GOTO ROTATE_FUNC
 BTFSC RTT ; Check for rotate
 GOTO ROTATE_FUNC
 BCF BUSY
 GOTO MAIN
;-------------------------
ROTATE_FUNC
 BCF DONE
 BSF BUSY
 CALL TRAY_LOC
 MOVLW D'12'
 MOVWF ROTATION_COUNTER
ROTATE_FUNC_AGN
 CALL EJECT_ROTATE_180 ; EJECT mechanism initialized
 CALL LOCK_RELEASE ; Release the lock
 CALL ROTATE
; Stopped at the next stack
 CALL TRAY_CHECK
 BTFSC TRAY_OK
 GOTO EXECUTED
 DECFSZ ROTATION_COUNTER,1
 GOTO ROTATE_FUNC_AGN
 BSF ERR
 BCF BUSY
 GOTO MAIN
 
;-----------------------
EXECUTED
 BCF ERR
 BSF DONE
 BCF BUSY
 GOTO MAIN
;;;;;;;;;;;;;;;;;;;;;;
TRAY_CHECK
 BCF TRAY_OK
 MOVFW TRAY_ADR
 BCF ZERO
 XORWF TRAY_POS,0
 BTFSC ZERO
 BSF TRAY_OK
 RETURN
;;;;;;;;;;;;;;;;;;;;;;
TRAY_POSITION
 CLRF TRAY_POS
 BTFSS IR0
 BSF TRAY_POS,0
 BTFSS IR1
 BSF TRAY_POS,1
 BTFSS IR2
 BSF TRAY_POS,2
 BTFSS IR3
 BSF TRAY_POS,3
 BSF POSITION_FLAG
 RETURN
;;;;;;;;;;;;;;;;;;;;;;
TRAY_LOC
 CLRF TRAY_ADR
 BTFSC ADR0
 BSF TRAY_ADR,0
 BTFSC ADR1
 BSF TRAY_ADR,1
 BTFSC ADR2
 BSF TRAY_ADR,2
 BTFSC ADR3
 BSF TRAY_ADR,3
 RETURN
;;;;;;;;;;;;;;;;;;;;;;;;
LOCK_EN
 CALL LOCK_ROTATE_180
 RETURN
;;;;;;;;;;;;;;;;;;;;;;;;;;;
LOCK_RELEASE
 CALL LOCK_ROTATE_90
 RETURN
;;;;;;;;;;;;;;;;;;;;;;;;;;;
EJECT
 BTFSS EJT ; Check for eject
 GOTO SKIP_EJECT
 BCF DONE
 BSF BUSY
 CALL EJECT_ROTATE_0
 CALL EJECT_ROTATE_180
 BCF BUSY
 BSF DONE
 RETURN
;------------------
SKIP_EJECT
 BCF BUSY
 RETURN
;;;;;;;;;;;;;;;;;;;;;;;;;;;
DELAY_180 ; (500uS)
 MOVLW D'50'
 MOVWF DEL1
LOOP182
 MOVLW D'2'
 MOVWF DEL2
LOOP181 
 DECFSZ DEL2,1
 GOTO LOOP181 
 DECFSZ DEL1,1
 GOTO LOOP182 
 RETURN
;;;;;;;;;;;;;;;;;;;
DELAY_00 ; (2.5mS)
 MOVLW D'250'
 MOVWF DEL1
LOOP02
 MOVLW D'2'
 MOVWF DEL2
LOOP01 
 DECFSZ DEL2,1
 GOTO LOOP01 
 DECFSZ DEL1,1
 GOTO LOOP02 
 RETURN
;;;;;;;;;;;;;;;;;;;
DELAY_90 ; (1.5mS)
 MOVLW D'205'
 MOVWF DEL1
LOOP2
 MOVLW D'1'
 MOVWF DEL2
LOOP1 
 DECFSZ DEL2,1
 GOTO LOOP1 
 DECFSZ DEL1,1
 GOTO LOOP2 
 RETURN
;;;;;;;;;;;;;;;;;;;;
DELAY2
 MOVLW D'180'
 MOVWF DEL1
LOOP12
 MOVLW D'10'
 MOVWF DEL2
LOOP11 
 DECFSZ DEL2,1
 GOTO LOOP11 
 DECFSZ DEL1,1
 GOTO LOOP12 
 RETURN
;;;;;;;;;;;;;;;;;;;;
DELAY_400mS
 MOVLW D'2'
 MOVWF DEL3
LOOP400mS3
 MOVLW D'254'
 MOVWF DEL1
LOOP400mS2
 MOVLW D'254'
 MOVWF DEL2
LOOP400mS1 
 DECFSZ DEL2,1
 GOTO LOOP400mS1 
 DECFSZ DEL1,1
 GOTO LOOP400mS2 
 DECFSZ DEL3,1
 GOTO LOOP400mS3 
 RETURN
;;;;;;;;;;;;;;;;;;;;
DELAY_200mS
 MOVLW D'254'
 MOVWF DEL1
LOOP200mS2
 MOVLW D'120'
 MOVWF DEL2
LOOP200mS1 
 DECFSZ DEL2,1
 GOTO LOOP200mS1 
 DECFSZ DEL1,1
 GOTO LOOP200mS2 
 RETURN
;;;;;;;;;;;;;;;;;;;;
DELAY_100mS
 MOVLW D'254'
 MOVWF DEL1
LOOP100mS2
 MOVLW D'60'
 MOVWF DEL2
LOOP100mS1 
 DECFSZ DEL2,1
 GOTO LOOP100mS1 
 DECFSZ DEL1,1
 GOTO LOOP100mS2 
 RETURN
;;;;;;;;;;;;;;;;;;;;;
EJECT_ROTATE_180
 MOVLW D'10'
 MOVWF T_ROTATE
EJECT_ROTATE_180_AGN
 BSF EJTPWM
 CALL DELAY_180
 BCF EJTPWM
 CALL DELAY_100mS
 DECFSZ T_ROTATE,1
 GOTO EJECT_ROTATE_180_AGN 
 RETURN
;;;;;;;;;;;;;;;;;;;;;;;;;;;
EJECT_ROTATE_0
 MOVLW D'10'
 MOVWF T_ROTATE
EJECT_ROTATE_0_AGN
 BSF EJTPWM
 CALL DELAY_00
 BCF EJTPWM
 CALL DELAY_100mS
 DECFSZ T_ROTATE,1
 GOTO EJECT_ROTATE_0_AGN 
 RETURN
;;;;;;;;;;;;;;;;;;;;;;;;;;;
LOCK_ROTATE_90
 MOVLW D'10'
 MOVWF T_ROTATE
LOCK_ROTATE_90_AGN
 BSF LOCKPWM
 CALL DELAY_90
 BCF LOCKPWM
 CALL DELAY_100mS
 DECFSZ T_ROTATE,1
 GOTO LOCK_ROTATE_90_AGN 
 RETURN
;;;;;;;;;;;;;;;;;;;;;;;;;;;
LOCK_ROTATE_180
 MOVLW D'10'
 MOVWF T_ROTATE
LOCK_ROTATE_180_AGN
 BSF LOCKPWM
 CALL DELAY_180
 BCF LOCKPWM
 CALL DELAY_100mS
 DECFSZ T_ROTATE,1
 GOTO LOCK_ROTATE_180_AGN 
 RETURN
;;;;;;;;;;;;;;;;;;;;;;;;;;;;;;
ROTATE
 BCF POSITION_FLAG 
 MOVLW D'100'
 MOVWF STEP_COUNT
STEP_1
 CALL STEP_0
 BSF ST4
 CALL INT_DEL_1
 BTFSC LOCK
 GOTO END_STEP
STEP_2
 CALL STEP_0
 BSF ST4
 BSF ST3
 CALL INT_DEL_1
 BTFSC LOCK
 GOTO END_STEP
STEP_3
 CALL STEP_0
 BSF ST3
 CALL INT_DEL_1
 BTFSC LOCK
 GOTO END_STEP
STEP_4
 CALL STEP_0
 BSF ST3
 BSF ST2
 CALL INT_DEL_1
 BTFSC LOCK
 GOTO END_STEP
STEP_5
 CALL STEP_0
 BSF ST2
 CALL INT_DEL_1
 BTFSC LOCK
 GOTO END_STEP
STEP_6
 CALL STEP_0
 BSF ST2
 BSF ST1
 CALL INT_DEL_1
 BTFSC LOCK
 GOTO END_STEP
STEP_7
 CALL STEP_0
 BSF ST1
 CALL INT_DEL_1
 BTFSC LOCK
 GOTO END_STEP
STEP_8
 CALL STEP_0
 BSF ST1
 BSF ST4
 CALL INT_DEL_1
 BTFSC LOCK
 GOTO END_STEP
 CALL TRAY_POSITION
 
 DECFSZ STEP_COUNT
 GOTO STEP_1
 MOVLW D'100'
 MOVWF STEP_COUNT
 BSF LOCKPWM
 CALL DELAY_180 ; Releasing lock
 BCF LOCKPWM
 
 GOTO STEP_1
;--------------------
END_STEP
 CALL STEP_0
 RETURN
;;;;;;;;;;;;;;;;;;;
STEP_0
 BCF ST1
 BCF ST2
 BCF ST3
 BCF ST4
 RETURN
;;;;;;;;;;;;;;;;;;;
INT_DEL_1
 MOVLW D'150' 
 MOVWF DEL1 
LOOP222
 MOVLW D'2'
 MOVWF DEL2
LOOP111
 BTFSC LOCK
 RETURN
 DECFSZ DEL2,1
 GOTO LOOP111
 DECFSZ DEL1,1
 GOTO LOOP222
 
 RETURN
;;;;;;;;;;;;;;;;;;
INT_DEL
 RETURN
;;;;;;;;;;;;;;;;;;;;;
 END
 